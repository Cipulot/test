## sdkconfig.defaults
```kconfig
CONFIG_IDF_TARGET="esp32p4"
CONFIG_ESPTOOLPY_FLASHSIZE_16MB=y
CONFIG_SPIRAM=y
CONFIG_SPIRAM_SPEED_200M=y
CONFIG_CACHE_L2_CACHE_256KB=y
CONFIG_CACHE_L2_CACHE_LINE_128B=y
CONFIG_ESP_MAIN_TASK_STACK_SIZE=8192
CONFIG_FATFS_LFN_HEAP=y
CONFIG_MBEDTLS_CERTIFICATE_BUNDLE=y
CONFIG_LV_COLOR_DEPTH_16=y
CONFIG_USB_HOST_CONTROL_TRANSFER_MAX_SIZE=256
```
